/* Copyright (c) 2012-2015, The Linux Foundation. All rights reserved.
 *
 * This program is free software; you can redistribute it and/or modify
 * it under the terms of the GNU General Public License version 2 and
 * only version 2 as published by the Free Software Foundation.
 *
 * This program is distributed in the hope that it will be useful,
 * but WITHOUT ANY WARRANTY; without even the implied warranty of
 * MERCHANTABILITY or FITNESS FOR A PARTICULAR PURPOSE.  See the
 * GNU General Public License for more details.
 */
&mdss_mdp {
	dsi_otm1901a_dj_1080p_video_otp: qcom,mdss_dsi_otm1901a_dj_1080p_video_otp {
		qcom,mdss-dsi-panel-name = "otm1901a_1080p_video_DJ_otp";
		qcom,mdss-dsi-panel-controller = <0x19c>;
		qcom,mdss-dsi-panel-type = "dsi_video_mode";
		qcom,mdss-dsi-panel-destination = "display_1";
		qcom,mdss-dsi-panel-framerate = <0x3b>;
		qcom,mdss-dsi-virtual-channel-id = <0x00>;
		qcom,mdss-dsi-stream = <0x00>;
		qcom,mdss-dsi-panel-width = <0x438>;
		qcom,mdss-dsi-panel-height = <0x780>;
		qcom,mdss-dsi-h-front-porch = <0x140>;
		qcom,mdss-dsi-h-back-porch = <0x20>;
		qcom,mdss-dsi-h-pulse-width = <0x04>;
		qcom,mdss-dsi-h-sync-skew = <0x00>;
		qcom,mdss-dsi-v-back-porch = <0x09>;
		qcom,mdss-dsi-v-front-porch = <0x0e>;
		qcom,mdss-dsi-v-pulse-width = <0x02>;
		qcom,mdss-dsi-h-left-border = <0x00>;
		qcom,mdss-dsi-h-right-border = <0x00>;
		qcom,mdss-dsi-v-top-border = <0x00>;
		qcom,mdss-dsi-v-bottom-border = <0x00>;
		qcom,mdss-dsi-bpp = <0x18>;
		qcom,mdss-dsi-underflow-color = <0xff>;
		qcom,mdss-dsi-border-color = <0x00>;
		qcom,mdss-dsi-on-command = <0x29010000 0x200 0x290100 0x04 0xff190101 0x29010000 0x200 0x80290100 0x03 0xff190129 0x1000000 0x20000 0x29010000 0x235 0x290100 0x02 0x802901 0x00 0x2c41329 0x1000000 0x20000 0x29010000 0x4ff 0xffffff05 0x1000078 0x21100 0x5010000 0x229 0x290100 0x02 0x2901 0x00 0x3991111>;
		qcom,mdss-dsi-off-command = [29 01 00 00 00 00 02 00 00 29 01 00 00 00 00 03 99 95 27 05 01 00 00 32 00 02 28 00 05 01 00 00 78 00 02 10 00 29 01 00 00 00 00 02 00 00 29 01 00 00 00 00 05 f7 5a a5 19 01 29 01 00 00 00 00 02 00 00 29 01 00 00 00 00 03 99 11 11];
		qcom,mdss-dsi-on-command-state = "dsi_lp_mode";
		qcom,mdss-dsi-off-command-state = "dsi_lp_mode";
		qcom,mdss-dsi-h-sync-pulse = <0x01>;
		qcom,mdss-dsi-traffic-mode = "burst_mode";
		qcom,mdss-dsi-bllp-eof-power-mode;
		qcom,mdss-dsi-bllp-power-mode;
		qcom,mdss-dsi-hfp-power-mode;
		qcom,mdss-dsi-lane-0-state;
		qcom,mdss-dsi-lane-1-state;
		qcom,mdss-dsi-lane-2-state;
		qcom,mdss-dsi-lane-3-state;
		qcom,mdss-dsi-panel-timings = <0x43e2a01 0x70762e42 0x33030400>;
		//renamed mdss-dsi-panel-timings-8996 to mdss-dsi-panel-timings-phy-v2. https://github.com/AOSPA/android_kernel_leeco_msm8996/commit/cb71a08bc124636fee1689af73c3c5a58de4c51d
		qcom,mdss-dsi-panel-timings-phy-v2 = <0x251f090a 0x60304a0 0x251f090a 0x60304a0 0x251f090a 0x60304a0 0x251f090a 0x60304a0 0x251e080a 0x60304a0>;
		qcom,mdss-dsi-t-clk-post = <0x02>;
		qcom,mdss-dsi-t-clk-pre = <0x2f>;
		qcom,mdss-dsi-bl-min-level = <0x01>;
		qcom,mdss-dsi-bl-max-level = <0xfff>;
		qcom,mdss-dsi-dma-trigger = "trigger_sw";
		qcom,mdss-dsi-mdp-trigger = "none";
		qcom,mdss-dsi-bl-pmic-control-type = "bl_ctrl_wled";
		qcom,mdss-dsi-reset-sequence = <0x01 0x0a 0x00 0x0a 0x01 0x0a>;
		qcom,esd-check-enabled;
		qcom,mdss-dsi-panel-status-command = <0x6010001 0x500010a 0x6010001 0x500010b>;
		qcom,mdss-dsi-panel-status-command-state = "dsi_hs_mode";
		qcom,mdss-dsi-panel-status-check-mode = "reg_read";
		qcom,mdss-dsi-panel-status-valid-params = <0x01 0x01>;
		qcom,mdss-dsi-panel-status-value = <0x9c 0x00>;
		qcom,mdss-dsi-panel-status-read-length = <0x01 0x01>;
		qcom,mdss-dsi-lp11-init;
		qcom,mdss-dsi-init-delay-us = <0x2710>;
		qcom,mdss-pan-physical-width-dimension = <0x44>;
		qcom,mdss-pan-physical-height-dimension = <0x78>;
	};
};
