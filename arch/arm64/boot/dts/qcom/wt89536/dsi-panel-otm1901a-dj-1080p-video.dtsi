/* Copyright (c) 2012-2015, The Linux Foundation. All rights reserved.
 *
 * This program is free software; you can redistribute it and/or modify
 * it under the terms of the GNU General Public License version 2 and
 * only version 2 as published by the Free Software Foundation.
 *
 * This program is distributed in the hope that it will be useful,
 * but WITHOUT ANY WARRANTY; without even the implied warranty of
 * MERCHANTABILITY or FITNESS FOR A PARTICULAR PURPOSE.  See the
 * GNU General Public License for more details.
 */
&mdss_mdp {
	dsi_otm1901a_dj_1080p_video: qcom,mdss_dsi_otm1901a_dj_1080p_video {
		qcom,mdss-dsi-panel-name = "otm1901a_1080p_video_DJ";
		qcom,mdss-dsi-panel-controller = <0x19c>;
		qcom,mdss-dsi-panel-type = "dsi_video_mode";
		qcom,mdss-dsi-panel-destination = "display_1";
		qcom,mdss-dsi-panel-framerate = <0x3c>;
		qcom,mdss-dsi-virtual-channel-id = <0x00>;
		qcom,mdss-dsi-stream = <0x00>;
		qcom,mdss-dsi-panel-width = <0x438>;
		qcom,mdss-dsi-panel-height = <0x780>;
		qcom,mdss-dsi-h-front-porch = <0x34>;
		qcom,mdss-dsi-h-back-porch = <0x3c>;
		qcom,mdss-dsi-h-pulse-width = <0x04>;
		qcom,mdss-dsi-h-sync-skew = <0x00>;
		qcom,mdss-dsi-v-back-porch = <0x0e>;
		qcom,mdss-dsi-v-front-porch = <0x0c>;
		qcom,mdss-dsi-v-pulse-width = <0x02>;
		qcom,mdss-dsi-h-left-border = <0x00>;
		qcom,mdss-dsi-h-right-border = <0x00>;
		qcom,mdss-dsi-v-top-border = <0x00>;
		qcom,mdss-dsi-v-bottom-border = <0x00>;
		qcom,mdss-dsi-bpp = <0x18>;
		qcom,mdss-dsi-underflow-color = <0xff>;
		qcom,mdss-dsi-border-color = <0x00>;
		qcom,mdss-dsi-on-command = [29 01 00 00 00 00 02 00 00 29 01 00 00 00 00 04 ff 19 01 01 29 01 00 00 00 00 02 00 80 29 01 00 00 00 00 03 ff 19 01 29 01 00 00 00 00 02 00 00 29 01 00 00 00 00 02 1c 33 29 01 00 00 00 00 02 00 a0 29 01 00 00 00 00 02 c1 e8 29 01 00 00 00 00 02 00 a7 29 01 00 00 00 00 02 c1 00 29 01 00 00 00 00 02 00 90 29 01 00 00 00 00 07 c0 00 2f 00 00 00 01 29 01 00 00 00 00 02 00 c0 29 01 00 00 00 00 07 c0 00 2f 00 00 00 01 29 01 00 00 00 00 02 00 9a 29 01 00 00 00 00 02 c0 1e 29 01 00 00 00 00 02 00 ac 29 01 00 00 00 00 02 c0 06 29 01 00 00 00 00 02 00 dc 29 01 00 00 00 00 02 c0 06 29 01 00 00 00 00 02 00 81 29 01 00 00 00 00 02 a5 04 29 01 00 00 00 00 02 00 84 29 01 00 00 00 00 02 c4 20 29 01 00 00 00 00 02 00 a5 29 01 00 00 00 00 02 b3 1d 29 01 00 00 00 00 02 00 92 29 01 00 00 00 00 02 e9 00 29 01 00 00 00 00 02 00 90 29 01 00 00 00 00 02 f3 01 29 01 00 00 00 00 02 00 b4 29 01 00 00 00 00 02 c0 d0 29 01 00 00 00 00 02 00 93 29 01 00 00 00 00 02 c5 19 29 01 00 00 00 00 02 00 95 29 01 00 00 00 00 02 c5 2d 29 01 00 00 00 00 02 00 97 29 01 00 00 00 00 02 c5 14 29 01 00 00 00 00 02 00 99 29 01 00 00 00 00 02 c5 29 29 01 00 00 00 00 02 00 00 29 01 00 00 00 00 03 d8 1d 1d 29 01 00 00 00 00 02 00 b3 29 01 00 00 00 00 02 c0 cc 29 01 00 00 00 00 02 00 b4 29 01 00 00 00 00 02 c0 80 29 01 00 00 00 00 02 00 bc 29 01 00 00 00 00 02 c0 00 29 01 00 00 00 00 02 00 f7 29 01 00 00 00 00 05 c3 04 18 04 04 29 01 00 00 00 00 02 00 81 29 01 00 00 00 00 02 a5 07 29 01 00 00 00 00 02 00 9d 29 01 00 00 00 00 02 c5 77 29 01 00 00 00 00 02 00 9b 29 01 00 00 00 00 03 c5 55 55 29 01 00 00 00 00 02 00 80 29 01 00 00 00 00 02 c4 15 29 01 00 00 00 00 02 00 80 29 01 00 00 00 00 0f c0 00 87 00 0a 0a 00 87 0a 0a 00 87 00 0a 0a 29 01 00 00 00 00 02 00 f0 29 01 00 00 00 00 07 c3 22 02 00 00 00 0c 29 01 00 00 00 00 02 00 a0 29 01 00 00 00 00 08 c0 00 00 00 00 03 22 03 29 01 00 00 00 00 02 00 d0 29 01 00 00 00 00 08 c0 00 00 00 00 03 22 03 29 01 00 00 00 00 02 00 90 29 01 00 00 00 00 09 c2 83 01 00 00 82 01 00 00 29 01 00 00 00 00 02 00 80 29 01 00 00 00 00 0d c3 82 02 03 00 03 84 81 03 03 00 03 84 29 01 00 00 00 00 02 00 90 29 01 00 00 00 00 0d c3 00 01 03 00 03 84 01 02 03 00 03 84 29 01 00 00 00 00 02 00 80 29 01 00 00 00 00 10 cc 09 0a 11 12 13 14 15 16 17 18 28 28 28 28 28 29 01 00 00 00 00 02 00 90 29 01 00 00 00 00 10 cc 0a 09 14 13 12 11 15 16 17 18 28 28 28 28 28 29 01 00 00 00 00 02 00 a0 29 01 00 00 00 00 10 cc 1d 1e 1f 19 1a 1b 1c 20 21 22 23 24 25 26 27 29 01 00 00 00 00 02 00 b0 29 01 00 00 00 00 09 cc 01 02 03 05 06 07 04 08 29 01 00 00 00 00 02 00 c0 29 01 00 00 00 00 0d cc 00 00 00 00 00 00 00 00 00 00 00 77 29 01 00 00 00 00 02 00 d0 29 01 00 00 00 00 0d cc 00 00 00 00 05 00 00 00 00 00 00 77 29 01 00 00 00 00 02 00 80 29 01 00 00 00 00 10 cb 00 00 00 00 00 00 00 00 00 00 00 00 00 00 00 29 01 00 00 00 00 02 00 90 29 01 00 00 00 00 10 cb 00 00 00 00 00 00 00 00 00 00 00 00 00 00 00 29 01 00 00 00 00 02 00 a0 29 01 00 00 00 00 10 cb 01 01 01 01 01 01 00 00 00 00 00 00 00 00 00 29 01 00 00 00 00 02 00 b0 29 01 00 00 00 00 10 cb 00 01 fd 00 00 00 00 00 00 00 00 00 00 00 00 29 01 00 00 00 00 02 00 c0 29 01 00 00 00 00 09 cb 00 00 00 00 00 00 77 77 29 01 00 00 00 00 02 00 d0 29 01 00 00 00 00 09 cb 00 00 00 00 00 00 77 77 29 01 00 00 00 00 02 00 e0 29 01 00 00 00 00 09 cb 00 00 00 00 00 00 77 77 29 01 00 00 00 00 02 00 f0 29 01 00 00 00 00 09 cb 01 01 01 00 00 00 77 77 29 01 00 00 00 00 02 00 80 29 01 00 00 00 00 10 cd 3f 3f 3f 3f 3f 3f 3f 3f 3f 02 12 11 3f 04 3f 29 01 00 00 00 00 02 00 90 29 01 00 00 00 00 0c cd 06 3f 3f 26 26 26 21 20 1f 26 26 29 01 00 00 00 00 02 00 a0 29 01 00 00 00 00 10 cd 3f 3f 3f 3f 3f 3f 3f 3f 3f 01 12 11 3f 03 3f 29 01 00 00 00 00 02 00 b0 29 01 00 00 00 00 0c cd 05 3f 3f 26 26 26 21 20 1f 26 26 29 01 00 00 00 00 02 00 00 29 01 00 00 00 00 19 e1 30 35 36 3a 40 44 46 52 58 66 6c 72 88 81 77 60 4d 39 2c 24 12 09 06 03 29 01 00 00 00 00 02 00 00 29 01 00 00 00 00 19 e2 30 35 36 3a 40 44 46 52 58 66 6c 72 88 81 77 60 4d 39 2c 24 12 09 06 03 29 01 00 00 00 00 02 00 00 29 01 00 00 00 00 19 e3 1c 1d 20 25 28 2c 36 43 48 59 63 6c 8d 84 7a 63 4d 39 2c 24 1d 11 07 03 29 01 00 00 00 00 02 00 00 29 01 00 00 00 00 19 e4 1c 1d 20 25 28 2c 36 43 48 59 63 6c 8d 84 7a 63 4d 39 2c 24 1d 11 07 03 29 01 00 00 00 00 02 00 00 29 01 00 00 00 00 19 e5 00 07 08 0d 13 1b 25 36 40 52 5f 69 8f 86 7b 63 4d 39 2c 24 1e 0d 04 03 29 01 00 00 00 00 02 00 00 29 01 00 00 00 00 19 e6 00 07 08 0d 13 1b 25 36 40 52 5f 69 8f 86 7b 63 4c 38 30 20 1e 0d 04 03 29 01 00 00 00 00 02 00 81 29 01 00 00 00 00 02 a5 07 29 01 00 00 00 00 02 00 80 29 01 00 00 00 00 02 c4 1a 29 01 00 00 00 00 02 00 9b 29 01 00 00 00 00 03 c5 55 50 29 01 00 00 00 00 02 00 f7 29 01 00 00 00 00 05 c3 04 16 04 04 29 01 00 00 00 00 02 00 f2 29 01 00 00 00 00 04 c1 80 00 00 29 01 00 00 00 00 02 00 9d 29 01 00 00 00 00 02 c5 77 29 01 00 00 00 00 02 00 f7 29 01 00 00 00 00 05 c3 00 ff 00 00 29 01 00 00 00 00 02 00 f2 29 01 00 00 00 00 04 c1 00 00 00 29 01 00 00 00 00 02 00 d0 29 01 00 00 00 00 05 f5 00 00 00 00 29 01 00 00 00 00 02 00 00 29 01 00 00 00 00 04 ff ff ff ff 29 01 00 00 00 00 02 51 00 29 01 00 00 00 00 02 53 24 05 01 00 00 78 00 02 11 00 05 01 00 00 00 00 02 29 00];
		qcom,mdss-dsi-off-command = [05 01 00 00 32 00 02 28 00 05 01 00 00 78 00 02 10 00 29 01 00 00 00 00 02 00 00 29 01 00 00 00 00 05 f7 5a a5 19 01];
		qcom,mdss-dsi-on-command-state = "dsi_lp_mode";
		qcom,mdss-dsi-off-command-state = "dsi_lp_mode";
		qcom,mdss-dsi-h-sync-pulse = <0x01>;
		qcom,mdss-dsi-traffic-mode = "burst_mode";
		qcom,mdss-dsi-bllp-eof-power-mode;
		qcom,mdss-dsi-bllp-power-mode;
		qcom,mdss-dsi-lane-0-state;
		qcom,mdss-dsi-lane-1-state;
		qcom,mdss-dsi-lane-2-state;
		qcom,mdss-dsi-lane-3-state;
		qcom,mdss-dsi-panel-timings = <0xdb342200 0x64662838 0x2b030400>;
		//renamed mdss-dsi-panel-timings-8996 to mdss-dsi-panel-timings-phy-v2. https://github.com/AOSPA/android_kernel_leeco_msm8996/commit/cb71a08bc124636fee1689af73c3c5a58de4c51d
		qcom,mdss-dsi-panel-timings-phy-v2 = <0x231f0709 0x50304a0 0x231f0709 0x50304a0 0x231f0709 0x50304a0 0x231f0709 0x50304a0 0x231a0708 0x50304a0>;
		qcom,mdss-dsi-t-clk-post = <0x03>;
		qcom,mdss-dsi-t-clk-pre = <0x29>;
		qcom,mdss-dsi-bl-min-level = <0x01>;
		qcom,mdss-dsi-bl-max-level = <0xfff>;
		qcom,mdss-dsi-dma-trigger = "trigger_sw";
		qcom,mdss-dsi-mdp-trigger = "none";
		qcom,mdss-dsi-bl-pmic-control-type = "bl_ctrl_wled";
		qcom,mdss-dsi-reset-sequence = <0x01 0x14 0x00 0x32 0x01 0x32>;
		qcom,esd-check-enabled;
		qcom,mdss-dsi-panel-status-command = [06 01 00 01 05 00 02 0a 08];
		qcom,mdss-dsi-panel-status-command-state = "dsi_lp_mode";
		qcom,mdss-dsi-panel-status-check-mode = "reg_read";
		qcom,mdss-dsi-panel-status-valid-params = <0x01>;
		qcom,mdss-dsi-panel-status-value = <0x9c>;
		qcom,mdss-dsi-panel-status-read-length = <0x01>;
		qcom,mdss-dsi-lp11-init;
		qcom,mdss-dsi-init-delay-us = <0xc350>;
		qcom,mdss-pan-physical-width-dimension = <0x44>;
		qcom,mdss-pan-physical-height-dimension = <0x78>;
		qcom,panel-supply-entries = <&dsi_panel_pwr_supply>;

	};
};
