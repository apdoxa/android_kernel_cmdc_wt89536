/* Copyright (c) 2012-2015, The Linux Foundation. All rights reserved.
 *
 * This program is free software; you can redistribute it and/or modify
 * it under the terms of the GNU General Public License version 2 and
 * only version 2 as published by the Free Software Foundation.
 *
 * This program is distributed in the hope that it will be useful,
 * but WITHOUT ANY WARRANTY; without even the implied warranty of
 * MERCHANTABILITY or FITNESS FOR A PARTICULAR PURPOSE.  See the
 * GNU General Public License for more details.
 */
&mdss_mdp {
	dsi_r63350_1080p_video: qcom,mdss_dsi_r63350_1080p_video {
		qcom,mdss-dsi-panel-name = "r63350_1080p_video_Tianma";
		qcom,mdss-dsi-panel-controller = <0x19c>;
		qcom,mdss-dsi-panel-type = "dsi_video_mode";
		qcom,mdss-dsi-panel-destination = "display_1";
		qcom,mdss-dsi-panel-framerate = <0x3b>;
		qcom,mdss-dsi-virtual-channel-id = <0x00>;
		qcom,mdss-dsi-stream = <0x00>;
		qcom,mdss-dsi-panel-width = <0x438>;
		qcom,mdss-dsi-panel-height = <0x780>;
		qcom,mdss-dsi-h-front-porch = <0x140>;
		qcom,mdss-dsi-h-back-porch = <0x24>;
		qcom,mdss-dsi-h-pulse-width = <0x0c>;
		qcom,mdss-dsi-h-sync-skew = <0x00>;
		qcom,mdss-dsi-v-back-porch = <0x04>;
		qcom,mdss-dsi-v-front-porch = <0x04>;
		qcom,mdss-dsi-v-pulse-width = <0x02>;
		qcom,mdss-dsi-h-left-border = <0x00>;
		qcom,mdss-dsi-h-right-border = <0x00>;
		qcom,mdss-dsi-v-top-border = <0x00>;
		qcom,mdss-dsi-v-bottom-border = <0x00>;
		qcom,mdss-dsi-bpp = <0x18>;
		qcom,mdss-dsi-color-order = "rgb_swap_rgb";
		qcom,mdss-dsi-underflow-color = <0xff>;
		qcom,mdss-dsi-border-color = <0x00>;
		qcom,mdss-dsi-on-command = [23 01 00 00 00 00 02 b0 04 29 01 00 00 00 00 07 b3 14 00 00 00
					00 00 29 01 00 00 00 00 03 b4 0c 00 29 01 00 00 00 00 04 b6 4b
					db 16 29 01 00 00 00 00 08 b8 57 3d 19 1e 0a 50 50 29 01 00 00
					00 00 08 b9 6f 3d 28 3c 14 c8 c8 29 01 00 00 00 00 08 ba b5 33
					41 64 23 a0 a0 29 01 00 00 00 00 03 bb 14 14 29 01 00 00 00 00
					03 bc 37 32 29 01 00 00 00 00 03 bd 64 32 23 01 00 00 00 00 02
					c0 00 29 01 00 00 00 00 23 c1 04 60 00 40 10 00 58 03 00 00 00
					64 84 30 4a 00 00 9d c1 01 00 ca 00 00 00 00 00 00 42 00 02 20
					03 98 29 01 00 00 00 00 09 c2 31 f7 80 06 08 00 00 08 29 01 00
					00 00 00 04 c3 00 00 00 29 01 00 00 00 00 0c c4 70 00 00 00 00
					00 00 00 00 01 06 29 01 00 00 00 00 16 c6 77 01 6e 02 67 00 00
					00 00 00 00 00 00 00 00 00 00 04 19 0a 77 29 01 00 00 00 00 1f
					c7 00 16 1d 25 32 3e 48 56 39 40 4b 57 61 68 77 00 16 1d 25 32
					3e 48 56 39 40 4b 57 61 68 77 29 01 00 00 00 00 10 cb e6 e0 c7
					63 00 00 00 00 20 e0 87 00 e8 00 00 23 01 00 00 00 00 02 cc 06
					29 01 00 00 00 00 1a ce 55 40 49 53 59 5e 63 68 6e 74 7e 8a 98
					a8 bb d0 ff 04 00 04 04 42 00 69 5a 29 01 00 00 00 00 0b d0 11
					00 00 56 cb 40 19 19 09 00 29 01 00 00 00 00 05 d1 00 48 16 0f
					29 01 00 00 00 00 1b d3 1b 33 99 bb b3 33 33 33 11 00 01 00 00
					e8 a0 02 2f 27 33 33 72 12 8a 57 3d bc 29 01 00 00 00 00 05 d4
					41 04 00 d5 23 01 00 00 00 00 02 d6 01 29 01 00 00 00 00 19 d7
					bf f8 7f a8 ce 3e fc c1 e1 ef 83 07 3f 10 7f c0 01 e7 40 3c 00
					c0 00 00 29 01 00 00 00 00 04 d9 20 00 14 29 01 00 00 00 00 05
					dd 30 06 23 65 29 01 00 00 00 00 05 de 00 3f ff 10 15 01 00 00
					20 00 02 29 00 15 01 00 00 80 00 02 11 00];
		qcom,mdss-dsi-off-command = <0x5010000 0x10000228 0x50100 0x780002 0x10002901 0x00 0x2b00429
					0x1000000 0x2b101>;
		qcom,mdss-dsi-on-command-state = "dsi_lp_mode";
		qcom,mdss-dsi-off-command-state = "dsi_hs_mode";
		qcom,mdss-dsi-init-last;
		qcom,mdss-dsi-h-sync-pulse = <0x01>;
		qcom,mdss-dsi-traffic-mode = "burst_mode";
		qcom,mdss-dsi-lane-map = "lane_map_0123";
		qcom,mdss-dsi-bllp-eof-power-mode;
		qcom,mdss-dsi-bllp-power-mode;
		qcom,mdss-dsi-lane-0-state;
		qcom,mdss-dsi-lane-1-state;
		qcom,mdss-dsi-lane-2-state;
		qcom,mdss-dsi-lane-3-state;
		qcom,mdss-dsi-panel-timings = <0x43e2a01 0x70762e42 0x33030400>;
		//renamed mdss-dsi-panel-timings-8996 to mdss-dsi-panel-timings-phy-v2. https://github.com/AOSPA/android_kernel_leeco_msm8996/commit/cb71a08bc124636fee1689af73c3c5a58de4c51d
		qcom,mdss-dsi-panel-timings-phy-v2 = <0x251f090a 0x60304a0 0x251f090a 0x60304a0 0x251f090a
						0x60304a0 0x251f090a 0x60304a0 0x251e080a 0x60304a0>;
		qcom,mdss-dsi-t-clk-post = <0x02>;
		qcom,mdss-dsi-t-clk-pre = <0x2f>;
		qcom,mdss-dsi-bl-min-level = <0x01>;
		qcom,mdss-dsi-bl-max-level = <0xfff>;
		qcom,mdss-dsi-dma-trigger = "trigger_sw";
		qcom,mdss-dsi-mdp-trigger = "none";
		qcom,mdss-dsi-bl-pmic-control-type = "bl_ctrl_wled";
		qcom,mdss-dsi-reset-sequence = <0x01 0x0a 0x00 0x0a 0x01 0x14>;
		qcom,mdss-dsi-hfp-power-mode;
		qcom,esd-check-enabled;
		qcom,mdss-dsi-panel-status-command = <0x6010001 0x500010a>;
		qcom,mdss-dsi-panel-status-command-state = "dsi_hs_mode";
		qcom,mdss-dsi-panel-status-check-mode = "reg_read";
		qcom,mdss-dsi-panel-status-valid-params = <0x01>;
		qcom,mdss-dsi-panel-status-value = <0x1c>;
		qcom,mdss-dsi-panel-status-read-length = <0x01>;
		qcom,mdss-dsi-lp11-init;
		qcom,mdss-dsi-init-delay-us = <0xc350>;
		qcom,mdss-pan-physical-width-dimension = <0x44>;
		qcom,mdss-pan-physical-height-dimension = <0x78>;

	};
};